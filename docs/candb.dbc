VERSION ""

NS_ :

BS_:

BU_: New_Node_1

BO_ 2147483649 New_Message_2: 8 Vector__XXX
 SG_ New_Signal_4 : 48|64@1- (1,0) [0|0] "" Vector__XXX
 SG_ New_Signal_5 : 23|32@0- (1,0) [0|0] "" Vector__XXX
 SG_ New_Signal_2 : 15|8@0+ (1,0) [0|0] ""  New_Node_1
 SG_ New_Signal_1 : 0|8@1- (1,0) [0|0] "" Vector__XXX

BO_ 2147483733 New_Message_1: 8 New_Node_1
 SG_ New_Signal_3 : 0|32@1- (1,0) [0|0] "" Vector__XXX

BA_DEF_ BO_  "CANFD_BRS" ENUM  "0","1";
BA_DEF_  "DBName" STRING ;
BA_DEF_  "BusType" STRING ;
BA_DEF_ BO_  "VFrameFormat" ENUM  "StandardCAN","ExtendedCAN","reserved","reserved","reserved","reserved","reserved","reserved","reserved","reserved","reserved","reserved","reserved","reserved","StandardCAN_FD","ExtendedCAN_FD";
BA_DEF_DEF_  "CANFD_BRS" "1";
BA_DEF_DEF_  "DBName" "";
BA_DEF_DEF_  "BusType" "";
BA_DEF_DEF_  "VFrameFormat" "StandardCAN";
BA_ "BusType" "CAN FD";
BA_ "DBName" "candb";
BA_ "VFrameFormat" BO_ 2147483649 15;
BA_ "VFrameFormat" BO_ 2147483733 1;
SIG_VALTYPE_ 2147483649 New_Signal_4 : 2;
SIG_VALTYPE_ 2147483649 New_Signal_5 : 1;
SIG_VALTYPE_ 2147483733 New_Signal_3 : 1;
